## firmware/keyboards/Kconfig.projbuild
```kconfig
menu "Keyboard Configuration"

    config KEYBOARD_DIR
        string "Keyboard to build"
        default "default"
        help
            Keyboard to build for. Found as a subdirectory of the keyboards component.

endmenu
```

## firmware/sdkconfig.defaults
```kconfig
# Default options for project

#
# Target
#
CONFIG_IDF_TARGET="esp32s3"

#
# Keyboard Configuration
#
# Variable uncommented by CI to override the keyboard config directory
# CONFIG_KEYBOARD_DIR="default"

#
# System
#
CONFIG_ESP_TASK_WDT_CHECK_IDLE_TASK_CPU0=y
CONFIG_ESP_TASK_WDT_CHECK_IDLE_TASK_CPU1=n

#
# Partition Table
#
CONFIG_PARTITION_TABLE_SINGLE_APP_LARGE=y

#
# Log output
#
CONFIG_LOG_DEFAULT_LEVEL_INFO=y
CONFIG_LOG_DEFAULT_LEVEL=3
CONFIG_LOG_MAXIMUM_LEVEL_DEBUG=y
CONFIG_LOG_MAXIMUM_LEVEL=4
CONFIG_LOG_TIMESTAMP_SOURCE_SYSTEM=y
CONFIG_ESP_CONSOLE_UART=y
CONFIG_ESP_CONSOLE_UART_CUSTOM=y
CONFIG_ESP_CONSOLE_UART_TX_GPIO=0
CONFIG_ESP_CONSOLE_UART_RX_GPIO=21
CONFIG_ESP_CONSOLE_USB_SERIAL_JTAG_ENABLED=y
CONFIG_ESP_CONSOLE_SECONDARY_USB_SERIAL_JTAG=y

#
# ESP PSRAM
#
CONFIG_SPIRAM=n

#
# Serial flasher config
#
CONFIG_ESPTOOLPY_NO_STUB=y
CONFIG_ESPTOOLPY_FLASHSIZE_8MB=y
CONFIG_ESPTOOLPY_HEADER_FLASHSIZE_UPDATE=y

#
# Bootloader config
#
CONFIG_BOOTLOADER_SKIP_VALIDATE_IN_DEEP_SLEEP=y


#
# Bluetooth
#
CONFIG_BT_ENABLED=y

#
# Bluetooth controller
#
CONFIG_BT_CTRL_PINNED_TO_CORE_0=y
CONFIG_BT_CTRL_MODEM_SLEEP=y

#
# Bluedroid Options
#
CONFIG_BT_BLUEDROID_PINNED_TO_CORE_0=y
CONFIG_BT_BLE_ENABLED=y
CONFIG_BT_BLE_50_FEATURES_SUPPORTED=y
CONFIG_BT_BLE_42_FEATURES_SUPPORTED=y


#
# TinyUSB Stack
#
CONFIG_TINYUSB=y
CONFIG_TINYUSB_NO_DEFAULT_TASK=y

#
# Communication Device Class (CDC)
#
CONFIG_TINYUSB_CDC_ENABLED=y
CONFIG_TINYUSB_CDC_COUNT=1

#
# Human Interface Device Class (HID)
#
CONFIG_TINYUSB_HID_COUNT=2
```

## sdkconfig.defaults
```kconfig
# Default options for project

#
# Bluetooth
#
CONFIG_BT_ENABLED=y

#
# Bluetooth controller
#
CONFIG_BT_CTRL_PINNED_TO_CORE_0=y

#
# Bluedroid Options
#
CONFIG_BT_CTRL_PINNED_TO_CORE_0=y
CONFIG_BT_BLUEDROID_PINNED_TO_CORE_0=y
CONFIG_BT_BLE_ENABLED=y
CONFIG_BT_BLE_50_FEATURES_SUPPORTED=y
CONFIG_BT_BLE_42_FEATURES_SUPPORTED=y


#
# Log output
#
CONFIG_LOG_DEFAULT_LEVEL_INFO=y
CONFIG_LOG_DEFAULT_LEVEL=3
CONFIG_LOG_MAXIMUM_LEVEL_DEBUG=y
CONFIG_LOG_MAXIMUM_LEVEL=4
CONFIG_LOG_TIMESTAMP_SOURCE_SYSTEM=y


#
# TinyUSB Stack
#
CONFIG_TINYUSB=y

#
# Communication Device Class (CDC)
#
CONFIG_TINYUSB_CDC_ENABLED=y


#
# System
#
CONFIG_ESP_TASK_WDT_CHECK_IDLE_TASK_CPU0=y
CONFIG_ESP_TASK_WDT_CHECK_IDLE_TASK_CPU1=n
```
